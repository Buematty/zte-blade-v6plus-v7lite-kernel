/*
 * Mediatek's LCM driver device tree
 *
 * Copyright (c) 2013 MediaTek Co., Ltd.
 *              http://www.mediatek.com
 *
 */

#include "lcm_define.h"

/ {
	/* LCM standardization */
	lcm_params {
		compatible = "mediatek,lcm_params-ili9806e_wvga_dsi_vdo";

		lcm_params-types = <2 0 0 0>;
		/* type, ctrl, lcm_if, lcm_cmd_if */
		lcm_params-resolution = <480 800>;
		/* width, height */
		lcm_params-io_select_mode;

		lcm_params-dbi-port;
		lcm_params-dbi-clock_freq;
		lcm_params-dbi-data_width;
		lcm_params-dbi-data_format = <0 0 0 0 0>;
		/* color_order, trans_seq, padding, format, width */
		lcm_params-dbi-cpu_write_bits;
		lcm_params-dbi-io_driving_current;
		lcm_params-dbi-msb_io_driving_current;
		lcm_params-dbi-ctrl_io_driving_current;

		lcm_params-dbi-te_mode = <1>;
		lcm_params-dbi-te_edge_polarity = <0>;
		lcm_params-dbi-te_hs_delay_cnt;
		lcm_params-dbi-te_vs_width_cnt;
		lcm_params-dbi-te_vs_width_cnt_div;

		lcm_params-dbi-serial-params0 = <0 0 0 0 0 0>;
		/* cs_polarity, clk_polarity, clk_phase, is_non_dbi_mode, clock_base, clock_div */
		lcm_params-dbi-serial-params1 = <0 0 0 0 0 0>;
		/* css, csh, rd_1st, rd_2nd, wr_1st, wr_2nd */
		lcm_params-dbi-serial-params2 = <0 0 0 0 0 0>;
		/* sif_1st_pol, sif_sck_def, sif_3wire, sif_sdi sif_div2, sif_hw_cs */
		lcm_params-dbi-parallel-params0 = <0 0 0 0>;
		/* write_setup, write_hold, write_wait, read_setup */
		lcm_params-dbi-parallel-params1 = <0 0 0 0>;
		/* read_hold, read_latency, wait_period, cs_high_width */

		lcm_params-dpi-mipi_pll_clk_ref;
		lcm_params-dpi-mipi_pll_clk_div1;
		lcm_params-dpi-mipi_pll_clk_div2;
		lcm_params-dpi-mipi_pll_clk_fbk_div;

		lcm_params-dpi-dpi_clk_div;
		lcm_params-dpi-dpi_clk_duty;
		lcm_params-dpi-PLL_CLOCK;
		lcm_params-dpi-dpi_clock;
		lcm_params-dpi-ssc_disable;
		lcm_params-dpi-ssc_range;

		lcm_params-dpi-width;
		lcm_params-dpi-height;
		lcm_params-dpi-bg_width;
		lcm_params-dpi-bg_height;

		lcm_params-dpi-clk_pol;
		lcm_params-dpi-de_pol;
		lcm_params-dpi-vsync_pol;
		lcm_params-dpi-hsync_pol;
		lcm_params-dpi-hsync_pulse_width;
		lcm_params-dpi-hsync_back_porch;
		lcm_params-dpi-hsync_front_porch;
		lcm_params-dpi-vsync_pulse_width;
		lcm_params-dpi-vsync_back_porch;
		lcm_params-dpi-vsync_front_porch;

		lcm_params-dpi-format;
		lcm_params-dpi-rgb_order;
		lcm_params-dpi-is_serial_output;
		lcm_params-dpi-i2x_en;
		lcm_params-dpi-i2x_edge;
		lcm_params-dpi-embsync;
		lcm_params-dpi-lvds_tx_en;
		lcm_params-dpi-bit_swap;
		lcm_params-dpi-intermediat_buffer_num;
		lcm_params-dpi-io_driving_current;
		lcm_params-dpi-lsb_io_driving_current;

		lcm_params-dsi-mode = <1>;
		lcm_params-dsi-switch_mode = <1>;
		lcm_params-dsi-DSI_WMEM_CONTI = <0x3C>;
		lcm_params-dsi-DSI_RMEM_CONTI = <0x3E>;
		lcm_params-dsi-VC_NUM;
		lcm_params-dsi-lane_num = <2>;
		lcm_params-dsi-data_format = <0 0 0 2>;
		/* color_order, trans_seq, padding, format */
		lcm_params-dsi-intermediat_buffer_num = <2>;
		lcm_params-dsi-ps = <2>;
		lcm_params-dsi-word_count;
		lcm_params-dsi-packet_size = <256>;

		lcm_params-dsi-vertical_sync_active = <4>;
		lcm_params-dsi-vertical_backporch = <16>;
		lcm_params-dsi-vertical_frontporch = <20>;
		lcm_params-dsi-vertical_frontporch_for_low_power;
		lcm_params-dsi-vertical_active_line = <800>;
		lcm_params-dsi-horizontal_sync_active = <20>;
		lcm_params-dsi-horizontal_backporch = <80>;
		lcm_params-dsi-horizontal_frontporch = <80>;
		lcm_params-dsi-horizontal_blanking_pixel;
		lcm_params-dsi-horizontal_active_pixel = <480>;
		lcm_params-dsi-horizontal_bllp;
		lcm_params-dsi-line_byte;
		lcm_params-dsi-horizontal_sync_active_byte;
		lcm_params-dsi-horizontal_backportch_byte;
		lcm_params-dsi-horizontal_frontporch_byte;
		lcm_params-dsi-rgb_byte;
		lcm_params-dsi-horizontal_sync_active_word_count;
		lcm_params-dsi-horizontal_backporch_word_count;
		lcm_params-dsi-horizontal_frontporch_word_count;

		lcm_params-dsi-HS_TRAIL;
		lcm_params-dsi-ZERO;
		lcm_params-dsi-HS_PRPR;
		lcm_params-dsi-LPX;
		lcm_params-dsi-TA_SACK;
		lcm_params-dsi-TA_GET;
		lcm_params-dsi-TA_SURE;
		lcm_params-dsi-TA_GO;
		lcm_params-dsi-CLK_TRAIL;
		lcm_params-dsi-CLK_ZERO;
		lcm_params-dsi-LPX_WAIT;
		lcm_params-dsi-CONT_DET;
		lcm_params-dsi-CLK_HS_PRPR;
		lcm_params-dsi-CLK_HS_POST;
		lcm_params-dsi-DA_HS_EXIT;
		lcm_params-dsi-CLK_HS_EXIT;

		lcm_params-dsi-pll_select;
		lcm_params-dsi-pll_div1;
		lcm_params-dsi-pll_div2;
		lcm_params-dsi-fbk_div;
		lcm_params-dsi-fbk_sel;
		lcm_params-dsi-rg_bir;
		lcm_params-dsi-rg_bic;
		lcm_params-dsi-rg_bp;
		lcm_params-dsi-pll_clock = <215>;
		lcm_params-dsi-dsi_clock;
		lcm_params-dsi-ssc_disable;
		lcm_params-dsi-ssc_range;
		lcm_params-dsi-compatibility_for_nvk;
		lcm_params-dsi-cont_clock;

		lcm_params-dsi-ufoe_enable;
		lcm_params-dsi-ufoe_params = <0 0 0 0>;
		/* compress_ratio, lr_mode_en, vlc_disable, vlc_config */
		lcm_params-dsi-edp_panel;

		lcm_params-dsi-customization_esd_check_enable = <0>;
		lcm_params-dsi-esd_check_enable = <0>;

		lcm_params-dsi-lcm_int_te_monitor;
		lcm_params-dsi-lcm_int_te_period;
		lcm_params-dsi-lcm_ext_te_monitor;
		lcm_params-dsi-lcm_ext_te_enable;

		lcm_params-dsi-noncont_clock;
		lcm_params-dsi-noncont_clock_period;
		lcm_params-dsi-clk_lp_per_line_enable = <0>;

		lcm_params-dsi-lcm_esd_check_table0 = <0x0A 0x01 0x9C 0x0>;
		/* cmd, count, para_list[0], para_list[1] */
		lcm_params-dsi-lcm_esd_check_table1;
		lcm_params-dsi-lcm_esd_check_table2;

		lcm_params-dsi-switch_mode_enable;
		lcm_params-dsi-dual_dsi_type;
		lcm_params-dsi-lane_swap_en;
		lcm_params-dsi-lane_swap0 = <0 0 0 0 0 0>;
		/* lane_swap[0][0~5] */
		lcm_params-dsi-lane_swap1 = <0 0 0 0 0 0>;
		/* lane_swap[1][0~5] */
		lcm_params-dsi-vertical_vfp_lp;
		lcm_params-physical_width;
		lcm_params-physical_height;
		lcm_params-od_table_size;
		lcm_params-od_table;
	};

	lcm_ops {
		compatible = "mediatek,lcm_ops-ili9806e_wvga_dsi_vdo";

		init = <LCM_FUNC_UTIL LCM_UTIL_RESET 1 LCM_UTIL_RESET_HIGH>,
			<LCM_FUNC_UTIL LCM_UTIL_MDELAY 1 10>,
			<LCM_FUNC_UTIL LCM_UTIL_RESET 1 LCM_UTIL_RESET_LOW>,
			<LCM_FUNC_UTIL LCM_UTIL_MDELAY 1 10>,
			<LCM_FUNC_UTIL LCM_UTIL_RESET 1 LCM_UTIL_RESET_HIGH>,
			<LCM_FUNC_UTIL LCM_UTIL_MDELAY 1 120>,
   <LCM_FUNC_CMD LCM_UTIL_WRITE_CMD_V2 7 0XFF 5 0XFF 0X98 0X06 0X04 0X01>,
   <LCM_FUNC_CMD LCM_UTIL_WRITE_CMD_V2 3 0X30 1 0X02>,
   <LCM_FUNC_CMD LCM_UTIL_WRITE_CMD_V2 3 0X31 1 0X02>,
   <LCM_FUNC_CMD LCM_UTIL_WRITE_CMD_V2 3 0X40 1 0X16>,
   <LCM_FUNC_CMD LCM_UTIL_WRITE_CMD_V2 3 0X41 1 0X55>,
   <LCM_FUNC_CMD LCM_UTIL_WRITE_CMD_V2 3 0X42 1 0X02>,
   <LCM_FUNC_CMD LCM_UTIL_WRITE_CMD_V2 3 0X43 1 0X09>,
   <LCM_FUNC_CMD LCM_UTIL_WRITE_CMD_V2 3 0X44 1 0X09>,
   <LCM_FUNC_CMD LCM_UTIL_WRITE_CMD_V2 3 0X46 1 0X55>,
   <LCM_FUNC_CMD LCM_UTIL_WRITE_CMD_V2 3 0X50 1 0X88>,
   <LCM_FUNC_CMD LCM_UTIL_WRITE_CMD_V2 3 0X51 1 0X88>,
   <LCM_FUNC_CMD LCM_UTIL_WRITE_CMD_V2 3 0X52 1 0X00>,
   <LCM_FUNC_CMD LCM_UTIL_WRITE_CMD_V2 3 0X53 1 0X4a>,
   <LCM_FUNC_CMD LCM_UTIL_WRITE_CMD_V2 3 0X57 1 0X50>,
   <LCM_FUNC_CMD LCM_UTIL_WRITE_CMD_V2 3 0X60 1 0X14>,
   <LCM_FUNC_CMD LCM_UTIL_WRITE_CMD_V2 3 0X61 1 0X00>,
   <LCM_FUNC_CMD LCM_UTIL_WRITE_CMD_V2 3 0X62 1 0X0a>,
   <LCM_FUNC_CMD LCM_UTIL_WRITE_CMD_V2 3 0X63 1 0X00>,
	
   <LCM_FUNC_CMD LCM_UTIL_WRITE_CMD_V2 3 0XA0 1 0X00>,
   <LCM_FUNC_CMD LCM_UTIL_WRITE_CMD_V2 3 0XA1 1 0X0C>,
   <LCM_FUNC_CMD LCM_UTIL_WRITE_CMD_V2 3 0XA2 1 0X17>,
   <LCM_FUNC_CMD LCM_UTIL_WRITE_CMD_V2 3 0XA3 1 0X11>,
   <LCM_FUNC_CMD LCM_UTIL_WRITE_CMD_V2 3 0XA4 1 0X09>,
   <LCM_FUNC_CMD LCM_UTIL_WRITE_CMD_V2 3 0XA5 1 0X16>,
   <LCM_FUNC_CMD LCM_UTIL_WRITE_CMD_V2 3 0XA6 1 0X09>,
   <LCM_FUNC_CMD LCM_UTIL_WRITE_CMD_V2 3 0XA7 1 0X08>,
   <LCM_FUNC_CMD LCM_UTIL_WRITE_CMD_V2 3 0XA8 1 0X04>,
   <LCM_FUNC_CMD LCM_UTIL_WRITE_CMD_V2 3 0XA9 1 0X09>,
   <LCM_FUNC_CMD LCM_UTIL_WRITE_CMD_V2 3 0XAA 1 0X06>,
   <LCM_FUNC_CMD LCM_UTIL_WRITE_CMD_V2 3 0XAB 1 0X04>,
   <LCM_FUNC_CMD LCM_UTIL_WRITE_CMD_V2 3 0XAC 1 0X0B>,
   <LCM_FUNC_CMD LCM_UTIL_WRITE_CMD_V2 3 0XAD 1 0X2E>,
   <LCM_FUNC_CMD LCM_UTIL_WRITE_CMD_V2 3 0XAE 1 0X2A>,
   <LCM_FUNC_CMD LCM_UTIL_WRITE_CMD_V2 3 0XAF 1 0X00>,
   <LCM_FUNC_CMD LCM_UTIL_WRITE_CMD_V2 3 0XC0 1 0X00>,
   <LCM_FUNC_CMD LCM_UTIL_WRITE_CMD_V2 3 0XC1 1 0X0C>,
   <LCM_FUNC_CMD LCM_UTIL_WRITE_CMD_V2 3 0XC2 1 0X17>,
   <LCM_FUNC_CMD LCM_UTIL_WRITE_CMD_V2 3 0XC3 1 0X11>,
   <LCM_FUNC_CMD LCM_UTIL_WRITE_CMD_V2 3 0XC4 1 0X09>,
   <LCM_FUNC_CMD LCM_UTIL_WRITE_CMD_V2 3 0XC5 1 0X16>,
   <LCM_FUNC_CMD LCM_UTIL_WRITE_CMD_V2 3 0XC6 1 0X09>,
   <LCM_FUNC_CMD LCM_UTIL_WRITE_CMD_V2 3 0XC7 1 0X08>,
   <LCM_FUNC_CMD LCM_UTIL_WRITE_CMD_V2 3 0XC8 1 0X03>,
   <LCM_FUNC_CMD LCM_UTIL_WRITE_CMD_V2 3 0XC9 1 0X08>,
   <LCM_FUNC_CMD LCM_UTIL_WRITE_CMD_V2 3 0XCA 1 0X06>,
   <LCM_FUNC_CMD LCM_UTIL_WRITE_CMD_V2 3 0XCB 1 0X04>,
   <LCM_FUNC_CMD LCM_UTIL_WRITE_CMD_V2 3 0XCC 1 0X0B>,
   <LCM_FUNC_CMD LCM_UTIL_WRITE_CMD_V2 3 0XCD 1 0X2E>,
   <LCM_FUNC_CMD LCM_UTIL_WRITE_CMD_V2 3 0XCE 1 0X2A>,
   <LCM_FUNC_CMD LCM_UTIL_WRITE_CMD_V2 3 0XCF 1 0X00>,

   <LCM_FUNC_CMD LCM_UTIL_WRITE_CMD_V2 7 0XFF 5 0XFF 0X98 0X06 0X04 0X06>,
   <LCM_FUNC_CMD LCM_UTIL_WRITE_CMD_V2 3 0X00 1 0X21>,
   <LCM_FUNC_CMD LCM_UTIL_WRITE_CMD_V2 3 0X01 1 0X04>,
   <LCM_FUNC_CMD LCM_UTIL_WRITE_CMD_V2 3 0X02 1 0X00>,
   <LCM_FUNC_CMD LCM_UTIL_WRITE_CMD_V2 3 0X03 1 0X01>,
   <LCM_FUNC_CMD LCM_UTIL_WRITE_CMD_V2 3 0X04 1 0X16>,
   <LCM_FUNC_CMD LCM_UTIL_WRITE_CMD_V2 3 0X05 1 0X16>,
   <LCM_FUNC_CMD LCM_UTIL_WRITE_CMD_V2 3 0X06 1 0X98>,
   <LCM_FUNC_CMD LCM_UTIL_WRITE_CMD_V2 3 0X07 1 0X02>,
   <LCM_FUNC_CMD LCM_UTIL_WRITE_CMD_V2 3 0X08 1 0X05>,
   <LCM_FUNC_CMD LCM_UTIL_WRITE_CMD_V2 3 0X09 1 0X00>,
   <LCM_FUNC_CMD LCM_UTIL_WRITE_CMD_V2 3 0X0A 1 0X00>,
   <LCM_FUNC_CMD LCM_UTIL_WRITE_CMD_V2 3 0X0B 1 0X00>,
   <LCM_FUNC_CMD LCM_UTIL_WRITE_CMD_V2 3 0X0C 1 0X15>,
   <LCM_FUNC_CMD LCM_UTIL_WRITE_CMD_V2 3 0X0D 1 0X15>,
   <LCM_FUNC_CMD LCM_UTIL_WRITE_CMD_V2 3 0X0E 1 0X00>,
   <LCM_FUNC_CMD LCM_UTIL_WRITE_CMD_V2 3 0X0F 1 0X00>,
   <LCM_FUNC_CMD LCM_UTIL_WRITE_CMD_V2 3 0X10 1 0X77>,
   <LCM_FUNC_CMD LCM_UTIL_WRITE_CMD_V2 3 0X11 1 0XF0>,
   <LCM_FUNC_CMD LCM_UTIL_WRITE_CMD_V2 3 0X12 1 0X00>,
   <LCM_FUNC_CMD LCM_UTIL_WRITE_CMD_V2 3 0X13 1 0X00>,
   <LCM_FUNC_CMD LCM_UTIL_WRITE_CMD_V2 3 0X14 1 0X00>,
   <LCM_FUNC_CMD LCM_UTIL_WRITE_CMD_V2 3 0X15 1 0XC0>,
   <LCM_FUNC_CMD LCM_UTIL_WRITE_CMD_V2 3 0X16 1 0X08>,
   <LCM_FUNC_CMD LCM_UTIL_WRITE_CMD_V2 3 0X17 1 0X00>,
   <LCM_FUNC_CMD LCM_UTIL_WRITE_CMD_V2 3 0X18 1 0X00>,
   <LCM_FUNC_CMD LCM_UTIL_WRITE_CMD_V2 3 0X19 1 0X00>,
   <LCM_FUNC_CMD LCM_UTIL_WRITE_CMD_V2 3 0X1A 1 0X00>,
   <LCM_FUNC_CMD LCM_UTIL_WRITE_CMD_V2 3 0X1B 1 0X00>,
   <LCM_FUNC_CMD LCM_UTIL_WRITE_CMD_V2 3 0X1C 1 0X00>,
   <LCM_FUNC_CMD LCM_UTIL_WRITE_CMD_V2 3 0X1D 1 0X00>,
   <LCM_FUNC_CMD LCM_UTIL_WRITE_CMD_V2 3 0X20 1 0X01>,
   <LCM_FUNC_CMD LCM_UTIL_WRITE_CMD_V2 3 0X21 1 0X23>,
   <LCM_FUNC_CMD LCM_UTIL_WRITE_CMD_V2 3 0X22 1 0X45>,
   <LCM_FUNC_CMD LCM_UTIL_WRITE_CMD_V2 3 0X23 1 0X67>,
   <LCM_FUNC_CMD LCM_UTIL_WRITE_CMD_V2 3 0X24 1 0X01>,
   <LCM_FUNC_CMD LCM_UTIL_WRITE_CMD_V2 3 0X25 1 0X23>,
   <LCM_FUNC_CMD LCM_UTIL_WRITE_CMD_V2 3 0X26 1 0X45>,
   <LCM_FUNC_CMD LCM_UTIL_WRITE_CMD_V2 3 0X27 1 0X67>,
   <LCM_FUNC_CMD LCM_UTIL_WRITE_CMD_V2 3 0X30 1 0X01>,
   <LCM_FUNC_CMD LCM_UTIL_WRITE_CMD_V2 3 0X31 1 0X22>,
   <LCM_FUNC_CMD LCM_UTIL_WRITE_CMD_V2 3 0X32 1 0X11>,
   <LCM_FUNC_CMD LCM_UTIL_WRITE_CMD_V2 3 0X33 1 0X00>,
   <LCM_FUNC_CMD LCM_UTIL_WRITE_CMD_V2 3 0X34 1 0X86>,
   <LCM_FUNC_CMD LCM_UTIL_WRITE_CMD_V2 3 0X35 1 0X68>,
   <LCM_FUNC_CMD LCM_UTIL_WRITE_CMD_V2 3 0X36 1 0X22>,
   <LCM_FUNC_CMD LCM_UTIL_WRITE_CMD_V2 3 0X37 1 0X22>,
   <LCM_FUNC_CMD LCM_UTIL_WRITE_CMD_V2 3 0X38 1 0XDA>,
   <LCM_FUNC_CMD LCM_UTIL_WRITE_CMD_V2 3 0X39 1 0XCB>,
   <LCM_FUNC_CMD LCM_UTIL_WRITE_CMD_V2 3 0X3A 1 0XBC>,
   <LCM_FUNC_CMD LCM_UTIL_WRITE_CMD_V2 3 0X3B 1 0XAD>,
   <LCM_FUNC_CMD LCM_UTIL_WRITE_CMD_V2 3 0X3C 1 0X22>,
   <LCM_FUNC_CMD LCM_UTIL_WRITE_CMD_V2 3 0X3D 1 0X22>,
   <LCM_FUNC_CMD LCM_UTIL_WRITE_CMD_V2 3 0X3E 1 0X22>,
   <LCM_FUNC_CMD LCM_UTIL_WRITE_CMD_V2 3 0X3F 1 0X22>,
   <LCM_FUNC_CMD LCM_UTIL_WRITE_CMD_V2 3 0X40 1 0X22>,	
   <LCM_FUNC_CMD LCM_UTIL_WRITE_CMD_V2 3 0X53 1 0X10>,	
	
   <LCM_FUNC_CMD LCM_UTIL_WRITE_CMD_V2 7 0XFF 5 0XFF 0X98 0X06 0X04 0X07>,
   <LCM_FUNC_CMD LCM_UTIL_WRITE_CMD_V2 3 0X02 1 0X77>,
   <LCM_FUNC_CMD LCM_UTIL_WRITE_CMD_V2 3 0X17 1 0X22>,
   <LCM_FUNC_CMD LCM_UTIL_WRITE_CMD_V2 3 0XE1 1 0X79>,
   <LCM_FUNC_CMD LCM_UTIL_WRITE_CMD_V2 3 0X06 1 0X13>,
	
	
   <LCM_FUNC_CMD LCM_UTIL_WRITE_CMD_V2 7 0XFF 5 0XFF 0X98 0X06 0X04 0X00>,
   <LCM_FUNC_CMD LCM_UTIL_WRITE_CMD_V2 3 0X51 1 0X00>,
   <LCM_FUNC_CMD LCM_UTIL_WRITE_CMD_V2 3 0X53 1 0X24>,
   <LCM_FUNC_CMD LCM_UTIL_WRITE_CMD_V2 3 0X55 1 0X01>,
			<LCM_FUNC_CMD LCM_UTIL_WRITE_CMD_V2 2 0x11 0>,
			<LCM_FUNC_UTIL LCM_UTIL_MDELAY 1 120>,
			<LCM_FUNC_CMD LCM_UTIL_WRITE_CMD_V2 2 0x29 0>,
			<LCM_FUNC_UTIL LCM_UTIL_MDELAY 1 40>;

		compare_id = <LCM_FUNC_CMD LCM_UTIL_WRITE_CMD_V1 5 1 0x00 0x37 0x03 0x00>,
			<LCM_FUNC_CMD LCM_UTIL_READ_CMD_V2 3 0xDA 1 0x96>,
			<LCM_FUNC_CMD LCM_UTIL_WRITE_CMD_V1 5 1 0x00 0x37 0x03 0x00>,
			<LCM_FUNC_CMD LCM_UTIL_READ_CMD_V2 3 0xDB 1 0x08>,
			<LCM_FUNC_CMD LCM_UTIL_WRITE_CMD_V1 5 1 0x00 0x37 0x03 0x00>,
			<LCM_FUNC_CMD LCM_UTIL_READ_CMD_V2 3 0xDC 1 0x00>;

		suspend = <LCM_FUNC_CMD LCM_UTIL_WRITE_CMD_V2 2 0x28 0>,
			<LCM_FUNC_UTIL LCM_UTIL_MDELAY 1 10>,
			<LCM_FUNC_CMD LCM_UTIL_WRITE_CMD_V2 2 0x10 0>,
			<LCM_FUNC_UTIL LCM_UTIL_MDELAY 1 120>;

		backlight = <LCM_FUNC_CMD LCM_UTIL_WRITE_CMD_V2 3 0x51 1 0xFF>;
	};
	/* LCM standardization end */
};

