## drivers/misc/mediatek/accelerometer/lis3dsh-new/Kconfig
```kconfig
config MTK_LIS3DSH_NEW

	bool "LIS3DSH for MediaTek package"
	default n
	help
	  It support different accelerometer sensor.
          If this option is set,
	  it will support
          LIS3DSH Accelerometer.
```

## drivers/misc/mediatek/hall/Kconfig
```kconfig
#
# Misc strange devices
#



config CLAMP_SWITCH
	bool "clamp switch"
	help
	Select this option to enable GPIO driver for the clamp IC
	chip gpio.	

	
config HALL_SWITCH
	bool "hall switch"
	depends on INPUT
	help
	Select this option to enable GPIO driver for the hall IC
	chip int.	
```

## drivers/spi/mediatek/Kconfig
```kconfig
#SPI
config MTK_SPI
	tristate "MediaTek SPI controller"
	#depends on SPI
	default n
	---help---
	This selects the MediaTek(R) SPI bus driver.
	If you want to use MediaTek(R) SPI interface, say Y or M here.  If unsure, say N.

config FINGERPRINT_GF3111X
	bool "gf311X"
	depends on INPUT
	help
	Select this option to support goodix fingerprint chip gf311x
	chip int.  
	
config FINGERPRINT_SYNAPTICS
	bool "syn"
	depends on INPUT
	help
	Select this option to support synaptics fingerprint chip 
	chip int.

config FINGERPRINT_ID_GPIO
	bool "fingerprint_id"
	help
	Select this option to use gpio identify different fingerprint model.
```
